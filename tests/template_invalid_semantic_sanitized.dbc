VERSION "SPECGO_TEMPLATE_1_0"

NS_ :

BS_:

BU_: ECU_TX ECU_RX

BO_ 257 SG_TEMPLATE_INVALID_SCALE: 8 ECU_TX
 SG_ bad_scale_signal : 0|8@1+ (0,0) [0|255] "" ECU_RX
 SG_ status_flag : 8|1@1+ (1,0) [0|1] "" ECU_RX
