VERSION "SPECGO_TEMPLATE_1_0"

NS_ :

BS_:

BU_: ECU_TX ECU_RX

BO_ 258 sg_template_roundtrip_mismatch_msg: 1 ECU_TX
 SG_ counter : 0|4@1+ (1,0) [0|15] "" ECU_RX
 SG_ mode : 4|4@1+ (1,0) [0|15] "" ECU_RX
